#include "IIC.h"
#include <INTRINS.H>
/*******************************************************************************
* 函 数 名         : I2C_Delay()
* 函数功能		   : 延时
* 输    入         : 无
* 输    出         : 无
*******************************************************************************/
void I2C_Delay()
{
    unsigned char i;
    _nop_();
    _nop_();
    _nop_();
    i = 10;
    while (--i)
        ;
}
/*******************************************************************************
* 函 数 名         : I2C_Start()
* 函数功能		   : 起始信号：在I2C_SCL时钟信号在高电平期间I2C_SDA信号产生一个下降沿
* 输    入         : 无
* 输    出         : 无
* 备    注         : 起始之后I2C_SDA和I2C_SCL都为0
*******************************************************************************/
void I2C_Start()
{
    I2C_SDA = 1; //拉高数据线
                 //    I2C_Delay10us();                 //延时
    I2C_SCL = 1; //拉高时钟线
    I2C_Delay(); //延时
    I2C_SDA = 0; //产生下降沿
    I2C_Delay(); //延时
    I2C_SCL = 0; //拉低时钟线
    I2C_Delay(); //延时
}

/*******************************************************************************
* 函 数 名           : I2C_Stop()
* 函数功能	         : 终止信号：在I2C_SCL时钟信号高电平期间I2C_SDA信号产生一个上升沿
* 输    入           : 无
* 输    出         	 : 无
* 备    注           : 结束之后保持I2C_SDA和I2C_SCL都为1；表示总线空闲
*******************************************************************************/
void I2C_Stop()
{
    I2C_SDA = 0; //拉低数据线
                 //	I2C_Delay();							 //延时
    I2C_SCL = 1; //拉高时钟线
    I2C_Delay(); //延时
    I2C_SDA = 1; //产生上升沿
    I2C_Delay(); //延时
}

//**************************************
//I2C发送应答信号
//入口参数:ack (0:ACK 1:NAK)
//**************************************
void I2C_SendACK(bit ack)
{
    I2C_SDA = ack; //写应答信号
    I2C_SCL = 1;   //拉高时钟线
    I2C_Delay();   //延时
    I2C_SCL = 0;   //拉低时钟线
    I2C_Delay();   //延时
}

//**************************************
//I2C接收应答信号
//**************************************
bit I2C_RecvACK()
{
    I2C_SCL = 1;  //拉高时钟线
    I2C_Delay();  //延时
    CY = I2C_SDA; //读应答信号
    I2C_SCL = 0;  //拉低时钟线
    I2C_Delay();  //延时
    return CY;
}

/*******************************************************************************
* 函 数 名           : I2cSendByte(uchar num)
* 函数功能 	         : 通过I2C发送一个字节。在I2C_SCL时钟信号高电平期间，
*                    * 保持发送信号I2C_SDA保持稳定
* 输    入           : num ,ack
* 输    出         	 : 0或1。发送成功返回1，发送失败返回0
* 备    注           : 发送完一个字节I2C_SCL=0, 需要应答则应答设置为1，否则为0
*******************************************************************************/
void I2C_SendByte(uchar dat)
{
    uchar i;
    for (i = 0; i < 8; i++) //8位计数器
    {
        I2C_SDA = dat >> 7; //送数据口
        dat <<= 1;          //移出数据的最高位
        I2C_SCL = 1;        //拉高时钟线
        I2C_Delay();        //延时
        I2C_SCL = 0;        //拉低时钟线
        I2C_Delay();        //延时
    }
    I2C_RecvACK();

    /*********也可以用下面的代码*******/
    //		uchar i;
    //    for (i=0; i<8; i++)         //8位计数器
    //    {
    //        dat <<= 1;              //移出数据的最高位
    //        I2C_SDA = CY;               //送数据口
    //        I2C_SCL = 1;                //拉高时钟线
    //        I2C_Delay();             //延时
    //        I2C_SCL = 0;                //拉低时钟线
    //        I2C_Delay();             //延时
    //    }
    //    I2C_RecvACK();
}

/*******************************************************************************
* 函 数 名           : I2cReadByte()
* 函数功能	    	 : 使用I2c读取一个字节
* 输    入           : 无
* 输    出         	 : dat
* 备    注           : 接收完一个字节I2C_SCL=0
*******************************************************************************/
uchar I2C_ReadByte()
{
    uchar i;
    uchar dat = 0;
    I2C_SDA = 1;            //使能内部上拉,准备读取数据
                            //		I2C_Delay();             //延时
    for (i = 0; i < 8; i++) //8位计数器
    {
        dat <<= 1;
        I2C_SCL = 1;    //拉高时钟线
        I2C_Delay();    //延时
        dat |= I2C_SDA; //读数据
        I2C_SCL = 0;    //拉低时钟线
        I2C_Delay();    //延时
    }
    return dat;
}

//**************************************
//指定地址下写入数据
//**************************************
void WriteI2C(uchar SlaveAddress, uchar REG_Address, uchar REG_data)
{
    I2C_Start();                //发送起始型信号
    I2C_SendByte(SlaveAddress); //发送设备地址
    I2C_SendByte(REG_Address);  //发送寄存器地址
    I2C_SendByte(REG_data);     //发送写入的数据
    I2C_Stop();                 //终止信号
}

//**************************************
//获取指定地址下的数据
//**************************************
uchar ReadI2C(uchar SlaveAddress, uchar REG_Address) //获取指定地址下的数据
{
    uchar REG_data;
    I2C_Start();                       //发送起始型信号
    I2C_SendByte(SlaveAddress);        //发送设备地址
    I2C_SendByte(REG_Address);         //发送寄存器地址
    I2C_Start();                       //发送起始型信号
    I2C_SendByte(SlaveAddress | 0x01); //发送设备地址
    REG_data = I2C_ReadByte();         //
    I2C_SendACK(1);                    //发送应答信号
    I2C_Stop();                        //终止信号
    return REG_data;
}
